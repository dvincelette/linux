## drivers/jesd204/Kconfig
```kconfig
#
# JESD204 subsystem configuration
#

menuconfig JESD204
	tristate "JESD204 support"
	help
	  The JESD204 is a "Serial Interface for data converters"
	  which describes a serialized interface between data converters
	  and logic devices. It contains normative information to enable
	  chip designers to implement devices that communicate with other
	  devices covered by this specification.

	  The JESD204 subsystem provides a unified framework for
	  supporting initialization and operation of JESD204 transceivers,
	  which aims at reducing complexity when managing these types of
	  devices.

if JESD204

endif # JESD204
```
